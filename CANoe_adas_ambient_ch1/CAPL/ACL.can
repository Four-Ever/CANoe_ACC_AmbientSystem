/*@!Encoding:65001*/
includes
{
  
}

variables
{
  double acltemp;
  int tmp=0;
  msTimer ACLTimer;
}

on timer ACLTimer{   //PEDAL Depth 계산
  if (@sysvar::Panel::Ped_acl==1){
    acltemp=acltemp+0.05;
  }
  else {
    acltemp=0;
  }
  if (acltemp >100){
    acltemp=100;
  }

  tmp = (int)acltemp;
  $C_CAN::ACL::ACL_Accel_msg::ACL_ped_per=tmp;

}

on start
{
  //$C_CAN::ACL::ACL_Accel_msg::ACL_ped_per=0;
  setTimerCyclic(ACLTimer, 5);
}

on message can2.CGW_PANEL_CDTC_msg  //진단메세지 송신
{
   message ACL_DTC_msg msgOut;
    msgOut.ACL_diagnosis = 1;
  output(msgOut);
  
  
}

on message can2.C_CAN::CGW_VCU_CWake_msg //  ECU 작동 시작
{
  if($C_CAN::CGW::CGW_VCU_CWake_msg::VCU_ACL_wakeup == 1)
  {
    write("Accel Im alive");

  }
  
  
}
on message can2.C_CAN::CGW_VCU_CSleep_msg //  ECU 작동 종료
{
  if($C_CAN::CGW::CGW_VCU_CSleep_msg::VCU_ACL_sleep ==1)
  {
    acltemp=0;
    write("Accel Im End");
  }
}

