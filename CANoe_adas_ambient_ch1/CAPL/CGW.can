/*@!Encoding:65001*/
includes
{
  
}

variables
{
  
}

//
on message can3.P_CAN::VCU_AWake_msg  ////P_CAN::VCU_AWake_msg
{
  message A_CAN::CGW_VCU_AWake_msg msgOut;
  msgOut.VCU_ACC_wakeup= this.VCU_ACC_wakeup;
  msgOut.VCU_AEB_wakeup= this.VCU_AEB_wakeup;
  msgOut.VCU_SCU_wakeup= this.VCU_SCU_wakeup;
  msgOut.can = 6;
  output(msgOut);
}
//A_CAN::VCU::VCU_ASleep_msg::VCU_AEB_sleepA_CAN::VCU::VCU_ASleep_msg::VCU_SCU_sleep
on message can3.P_CAN::VCU_ASleep_msg
{  
  message A_CAN::CGW_VCU_ASleep_msg msgOut;
  msgOut.VCU_ACC_sleep= this.VCU_ACC_sleep;
  msgOut.VCU_AEB_sleep= this.VCU_AEB_sleep;
  msgOut.VCU_SCU_sleep= this.VCU_SCU_sleep;
  msgOut.can = 6;
  output(msgOut);
}
on message can3.P_CAN::VCU_ACCBrk_msg
{  
  message A_CAN::CGW_VCU_ACCBrk_msg msgOut;
  msgOut.VCU_ACC_brksleep = this.VCU_ACC_brksleep;
  msgOut.can = 6;
  output(msgOut);
}


on message can4.UI_CAN::HMI_ACC_Level_msg
{  
  message A_CAN::CGW_HMI_ACC_Level_msg msgOut;
  msgOut.HMI_ACC_levelup= this.HMI_ACC_levelup;
  msgOut.HMI_ACC_leveldown= this.HMI_ACC_leveldown;
  msgOut.can = 6;
  output(msgOut);
}

on message can4.UI_CAN::HMI_ACC_Speed_msg
{  
  message A_CAN::CGW_HMI_ACC_Speed_msg msgOut;
  msgOut.HMI_ACC_speedup= this.HMI_ACC_speedup;
  msgOut.HMI_ACC_speeddown= this.HMI_ACC_speeddown;
  msgOut.can = 6;
  output(msgOut);
}

on message can4.UI_CAN::HMI_ACC_Power_msg
{  
  message A_CAN::CGW_HMI_ACC_Power_msg msgOut;
  msgOut.HMI_ACC_on= this.HMI_ACC_on;
  msgOut.HMI_ACC_off= this.HMI_ACC_off;
  msgOut.can = 6;
  output(msgOut);
}

on message can4.UI_CAN::PANEL_FCar_msg
{  
  message A_CAN::CGW_PANEL_FCar_msg msgOut;
  msgOut.Scenario_Leading_car= this.Scenario_Leading_car;
  msgOut.can = 6;
  output(msgOut);
}

on message can4.UI_CAN::PANEL_FColl_msg
{ 
  message A_CAN::CGW_PANEL_FColl_msg msgOut;
  msgOut.Scenario_Interruptingcar1= this.Scenario_Interruptingcar1;
  msgOut.can = 6;
  output(msgOut);
}

on message can4.UI_CAN::PANEL_AEB_msg
{  
  message A_CAN::CGW_PANEL_AEB_msg msgOut;
  msgOut.Scenario_Interruptingcar2= this.Scenario_Interruptingcar2;
  msgOut.can = 6;
  output(msgOut);
}

on message can4.UI_CAN::PANEL_ACC_msg
{  
  message A_CAN::CGW_PANEL_ACC_msg msgOut;
  msgOut.Scenario_Interruptingcar3= this.Scenario_Interruptingcar3;
  msgOut.can = 6;
  output(msgOut);
}

on message can4.UI_CAN::PANEL_RColl_msg
{  
  message A_CAN::CGW_PANEL_RColl_msg msgOut;
  msgOut.Scenario_Rear_collision= this.Scenario_Rear_collision;
  msgOut.can = 6;
  output(msgOut);
}

on message can4.UI_CAN::PANEL_ADTC_msg
{  
  message A_CAN::CGW_PANEL_ADTC_msg msgOut;
  msgOut.Scenario_ACCrequest= this.Scenario_ACCrequest;
  msgOut.Scenario_AEBrequest= this.Scenario_AEBrequest;
  msgOut.Scenario_ECUrequest= this.Scenario_ECUrequest;
  msgOut.can = 6;
  output(msgOut);
}
////////////////////////////////////////////////////////////////////////////

on message can3.P_CAN::VCU_UWake_msg
{  
  message UI_CAN::CGW_VCU_UWake_msg msgOut;
  msgOut.VCU_CLU_wakeup= this.VCU_CLU_wakeup;
  msgOut.VCU_HMI_wakeup= this.VCU_HMI_wakeup;
  msgOut.VCU_Panel_wakeup= this.VCU_Panel_wakeup;
  msgOut.can = 4;
  output(msgOut);
}

on message can3.P_CAN::VCU_USleep_msg
{  
  message UI_CAN::CGW_VCU_USleep_msg msgOut;
  msgOut.VCU_CLU_sleep= this.VCU_CLU_sleep;
  msgOut.VCU_HMI_sleep= this.VCU_HMI_sleep;
  msgOut.VCU_Panel_sleep= this.VCU_Panel_sleep; 
  msgOut.can = 4;
  output(msgOut);
}

on message can3.P_CAN::ACC_DState_msg
{  
  message UI_CAN::CGW_ACC_DState_msg2 msgOut;
  msgOut.ACC_brk_off= this.ACC_brk_off;
  msgOut.can = 4;
  output(msgOut);
}

on message can3.P_CAN::VCU_CWake_msg
{  
  message C_CAN::CGW_VCU_CWake_msg msgOut;
  msgOut.VCU_BRK_wakeup= this.VCU_BRK_wakeup;
  msgOut.VCU_ACL_wakeup= this.VCU_ACL_wakeup;
  msgOut.can = 2;
  output(msgOut);
}

on message can3.P_CAN::VCU_CSleep_msg
{  
  message C_CAN::CGW_VCU_CSleep_msg msgOut;
  msgOut.VCU_BRK_sleep= this.VCU_BRK_sleep;
  msgOut.VCU_ACL_sleep= this.VCU_ACL_sleep;
  msgOut.can = 2;
  output(msgOut);
}



///1번 B
//2번 C
//3 P
//4 UI_CAN
//5 OBD_CAN
//6 ADAS