/*@!Encoding:65001*/
includes
{
  
}

variables
{
  //msTimer testTimer;
  int gCounter;
  
  byte isActive = 0; // wake/sleep
  byte isDTC_required = 0;
  
  byte byteCCM_target_acl = 0;
  byte byteCCM_target_brk = 0;
  
  byte byteCCM_acl = 0;
  byte byteCCM_brk = 0;
  
  dword dwCCM_DTCcode;
}

on start
{
  
  //setTimer(testTimer, 10);
}

on message can3.VCU_AWake_msg
{
  isActive = 1;
}


on message can3.VCU_ASleep_msg
{
  isActive = 0;
}

on message can3.CGW_ACC_AlterSpeed_msg
{
  //if (isActive) {
    byteCCM_target_acl = this.ACC_accel_trk;
    byteCCM_target_brk = this.ACC_brk_pbar;

    $P_CAN::CCM::CCM_Accel_msg::CCU_accel_trk = byteCCM_target_acl;
    $P_CAN::CCM::CCM_Brk_msg::CCU_brk_pbar = byteCCM_target_brk;
  //}
}


on message can3.CGW_PANEL_PDTC_msg
{
  message CCM_DTC_msg CCMDTC;
  CCMDTC.CCM_diagnosis=1;  ///정상이면 1, 비정상이면2
  output(CCMDTC);

}
