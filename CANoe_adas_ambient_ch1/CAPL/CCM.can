/*@!Encoding:65001*/
includes
{
  
}

variables
{
  byte isActive = 0; // wake/sleep
  
  message P_CAN::CCM_Accel_msg Accel_msg;
  message P_CAN::CCM_Brk_msg Brk_msg;
  dword dwCCM_DTCcode;
}


on message can3.VCU_PWake_msg
{
  if(this.VCU_CCM_wakeup == 1) {
    isActive = 1;
    write("CCM ALIVE!!");
  }
}


on message can3.VCU_PSleep_msg
{
  if(this.VCU_CCM_sleep == 1) {
    isActive = 0;
    write("CCM DIE!!");
  }
}

on message can3.CGW_ACC_AlterSpeed_msg
{
  if (isActive) {
    Accel_msg.CCU_accel_trk = this.ACC_accel_trk;
    Brk_msg.CCU_brk_pbar = this.ACC_brk_pbar;
    
    output(Accel_msg);
    output(Brk_msg);
  }
}


on message can3.CGW_PANEL_PDTC_msg
{
  message CCM_DTC_msg CCMDTC;
  CCMDTC.CCM_diagnosis=1;  ///정상이면 1, 비정상이면2
  output(CCMDTC);

}
