/*@!Encoding:65001*/
includes
{
  
}

variables
{
  enum seat_state{
    default_state = 0,   // 기본 상태
    accident_state       // 후방 충돌 발생. 뒤로 젖혀짐
  };
  enum seat_enable_state{
    normal = 0,   // 정상 상태
    abnormal      // 비정상 상태
  };
  
  enum Boolean{
    False = 0,
    True
  };
  // word dr_seat_state = 0; // 시스템 변수
  // word pass_seat_state = 0; // 시스템 변수 
  // word dr_seat_condi = 0; // 시스템 변수
  // word pass_seat_condi = 0; // 시스템 변수
  int local_pass_seat_OCC = 0; //
  msTimer SEAT_State_timer; // IL로 구현 가능
  msTimer SEAT_Belt_state_timer;
  msTimer SEAT_Dr_Condi_timer;
  msTimer SEAT_Ast_Condi_timer;
  msTimer drv_seat_Belt_state_timer; // 2초 뒤 안전벨트 차기
  msTimer pass_seat_Belt_state_timer; // 2초 뒤 안전벨트 차기
  // 2초 뒤 안전 벨트 착용
  
  byte Power_on_off_flag = False; // seat 시동 후에만 작동 해야함
}
on start{ // init
  init();
  // IL 구현시 아래 부분 제외해야함
  if(@sysvar::Dev_Option::Timer_Enable)
  {
    setTimerCyclic(SEAT_State_timer, 1000);
    setTimerCyclic(SEAT_Belt_state_timer, 1000);
    setTimerCyclic(SEAT_Dr_Condi_timer, 1000);
    setTimerCyclic(SEAT_Ast_Condi_timer, 1000);
  }
}
on preStop{ // 종료 직전 수행
  init();
}

///////////////////////////////
on timer drv_seat_Belt_state_timer // 2초 뒤 안전 벨트
{
  @sysvar::SEAT_Value::dr_seat_Belt_state = 1;
  @sysvar::SEAT_Value::dr_panel_seatbelt_state = 2; // 벨트 착용
  
}
on timer pass_seat_Belt_state_timer // 2초 뒤 안전 벨트
{
  @sysvar::SEAT_Value::pass_seat_Belt_state = 1;
  @sysvar::SEAT_Value::pass_panel_seatbelt_state = 2; // 벨트 착용
}

on timer SEAT_State_timer{ // 사용자 착석 상태
  message SEAT_State_msg msg;
  msg.SEAT_drvseatOCC = @sysvar::SEAT_Value::dr_seat_OCC;
  msg.SEAT_astseatOCC = local_pass_seat_OCC;
  output(msg);
}
on timer SEAT_Belt_state_timer{ // 사용자 벨트 착용 상태
  message SEAT_Belt_state_msg msg;
  msg.SEAT_drvseatBelt = @sysvar::SEAT_Value::dr_seat_Belt_state;
  msg.SEAT_astseatBelt = @sysvar::SEAT_Value::pass_seat_Belt_state;
  output(msg);
  // setTimer(SEAT_Belt_state_timer, 1000);
}
on timer SEAT_Dr_Condi_timer{ // 운전자 좌석시트 동작 가능 상태
  message SEAT_Dr_Condi_msg msg;
  switch(@sysvar::SEAT_Value::dr_seat_condi)
  {
    case normal:
      {
        msg.SEAT_drvnormal = True;
        msg.SEAT_drvabnormal = False;
        break; 
      }
    case abnormal:
      {
        msg.SEAT_drvnormal = False;
        msg.SEAT_drvabnormal = True;
        break; 
      }
    default:
      break;  
  }  
  output(msg);
  //setTimer(SEAT_Dr_Condi_timer, 1000);
}
on timer SEAT_Ast_Condi_timer{ // 조수석 좌석시트 동작 가능 상태
  message SEAT_Ast_Condi_msg msg;
  switch(@sysvar::SEAT_Value::pass_seat_condi)
  {
    case normal:
      {
        msg.SEAT_astnormal = True;
        msg.SEAT_astabnormal = False;
        break; 
      }
    case abnormal:
      {
        msg.SEAT_astnormal = False;
        msg.SEAT_astabnormal = True;
        break; 
      }
    default:
      break;  
  }
  output(msg);
  //setTimer(SEAT_Ast_Condi_timer, 1000);
}
///////////////////////////////

on sysvar_update sysvar::SEAT_Value::dr_seat_OCC // 2 sec
{
  //Dr_Seat_State_Change();
  if(@sysvar::SEAT_Value::dr_seat_OCC == 1){
    setTimer(drv_seat_Belt_state_timer, 2000);
  }
}

on sysvar_update sysvar::SEAT_Value::pass_seat_OCC // 1 Computer에서 테스트 하기 용도.
{
  //Pass_Seat_State_Change();
  if(@sysvar::SEAT_Value::pass_seat_OCC == 1){
    local_pass_seat_OCC = 1;
    @sysvar::SEAT_Value::pass_panel_seatbelt_state = 1;
    setTimer(pass_seat_Belt_state_timer, 2000);
  }
}
//on sysvar_update sysvar::SEAT_Value::pass_seat_OCC // 2 sec
on message can1.CGW_PANEL_Boarding_msg// 시나리오 패널 서버 분리를 위한 처리
{
    //Pass_Seat_State_Change();
  //if(@sysvar::SEAT_Value::pass_seat_OCC == 1){
    local_pass_seat_OCC = 1;
    @sysvar::SEAT_Value::pass_panel_seatbelt_state = 1;
    setTimer(pass_seat_Belt_state_timer, 2000);
  //}
}

on message can1.BCU_Seat_msg // 충돌에 의한 좌석 제어 요청 (BCU -> Seat)
{
//  if(Power_on_off_flag)
//  {
//  }
     if(this.BCU_dr_seatstate && @sysvar::SEAT_Value::dr_seat_condi == normal){ // 운전자 착석 상태
      @sysvar::SEAT_Value::dr_seat_state = accident_state;
      @sysvar::SEAT_Value::dr_panel_seatbelt_state = 3;
    }
    if(this.BCU_pass_seatstate && @sysvar::SEAT_Value::pass_seat_condi == normal){ // 조수석 착석 상태
      @sysvar::SEAT_Value::pass_seat_state = accident_state;
      @sysvar::SEAT_Value::pass_panel_seatbelt_state = 3;
    }
}

on message can1.CGW_VCU_BWake_msg // Seat ECU 작동 시작
{
  if($B_CAN::CGW::CGW_VCU_BWake_msg::VCU_Seat_wakeup == 1)
  {
    write("Seat Im alive");
    init();
    Power_on_off_flag = True;
    // 정상 상태
    @sysvar::SEAT_Value::dr_seat_OCC = True; // 시동이 걸렸으므로 운전자 탑승하고 있다고 판단
    @sysvar::SEAT_Value::dr_panel_seatbelt_state = 1; // 기본값 0
    @sysvar::SEAT_Value::pass_panel_seatbelt_state = 0;
  }
}
on message can1.CGW_VCU_BSleep_msg // Seat ECU 작동 종료
{
  if($B_CAN::CGW::CGW_VCU_BSleep_msg::VCU_Seat_sleep ==1)
  {
    write("Seat Im End");
    init();
    Power_on_off_flag = False;
    
  }
}
on message can1.CGW_PANEL_BDTC_msg // Seat ECU 진단 정보 요청
{
  //if($CGW::Scenario_Seatrequest == 1)
  //{
    message SEAT_DTC_msg seat_dtc_msg;
    // 진단 내용 정의 필요
    seat_dtc_msg.SEAT_diagnosis = 1;
    output(seat_dtc_msg); // 전송
  //}
}

void init()
{
  // 시스템 변수 및 전역변수 초기화
  Power_on_off_flag = False;
  @sysvar::SEAT_Value::dr_seat_condi = normal;
  @sysvar::SEAT_Value::pass_seat_condi = normal;
  @sysvar::SEAT_Value::dr_seat_state = default_state;
  @sysvar::SEAT_Value::pass_seat_state = default_state;
  @sysvar::SEAT_Value::dr_seat_Belt_state = False;
  @sysvar::SEAT_Value::pass_seat_Belt_state = False;
  @sysvar::SEAT_Value::dr_seat_OCC = False;
  @sysvar::SEAT_Value::pass_seat_OCC = False;
  local_pass_seat_OCC=0;
  @sysvar::SEAT_Value::dr_panel_seatbelt_state = 0; // 기본값 0
  @sysvar::SEAT_Value::pass_panel_seatbelt_state = 0;
  
}
void Dr_Seat_State_Change() // 패널 시스템 변수 추가
{
  int tmp_state = 0;
  if(@sysvar::SEAT_Value::dr_seat_OCC == 1) tmp_state = 1;
  if(@sysvar::SEAT_Value::dr_seat_OCC == 1 && @sysvar::SEAT_Value::dr_seat_Belt_state == 1) tmp_state = 2;
  if(@sysvar::SEAT_Value::dr_seat_OCC == 1 && @sysvar::SEAT_Value::dr_seat_state == accident_state) tmp_state = 3;
  @sysvar::SEAT_Value::dr_panel_seatbelt_state = tmp_state;
}
void Pass_Seat_State_Change() // 패널 시스템 변수 추가
{
  int tmp_state = 0;
  if(@sysvar::SEAT_Value::pass_seat_OCC == 1) tmp_state = 1;
  if(@sysvar::SEAT_Value::pass_seat_OCC == 1 && @sysvar::SEAT_Value::pass_seat_Belt_state == 1) tmp_state = 2;
  if(@sysvar::SEAT_Value::pass_seat_OCC == 1 && @sysvar::SEAT_Value::pass_seat_state == accident_state) tmp_state = 3;
  @sysvar::SEAT_Value::pass_panel_seatbelt_state = tmp_state;
}
// 패널 부분에서 고려할 부분
// 시동 버튼 누를 시, 자동으로 탑승 여부 변경 -> 몇초 후 벨트 시그널 변경
// 조수석 탑승 버튼 누를 시, 조수석 탑승 여부 변경 -> 몇초 후 벨트 시그널 값 변경
