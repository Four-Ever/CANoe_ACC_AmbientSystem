/*@!Encoding:65001*/
includes
{
  
}

variables
{
  msTimer VCUTimer;
}

on timer VCUTimer{
  $P_CAN::VCU::VCU_State_msg::VCU_speed_kph = @sysvar::VCU_Tx::speed;
  $P_CAN::VCU::VCU_State_msg::VCU_rpm = @sysvar::VCU_Tx::rpm;
  //브레이크등 패널
  if ((@sysvar::VCU_Rx::ACC_brk ==0 || @sysvar::VCU_Rx::ACC_brk ==110) && @sysvar::VCU_Rx::AEB_brk==0 && @sysvar::VCU_Rx::dr_brk_ped == 0 && @sysvar::VCU_Rx::dr_brkfull == 0 ){
      @sysvar::Panel::brk_light=0;
  }
  else if( (@sysvar::VCU_Rx::ACC_accel >0 && @sysvar::VCU_Rx::ACC_accel <=100)||(@sysvar::VCU_Rx::dr_accel_ped>0)){
    @sysvar::Panel::brk_light=1;
  }
  else {
      @sysvar::Panel::brk_light=1;
  }
  
  
}


on start {  
  @sysvar::VCU_Rx::AEB_brk=0; 
  setTimerCyclic(VCUTimer, 5);
}

void changewakeup(){
  message VCU_AWake_msg ACANwakeup;
  message VCU_CWake_msg CCANwakeup;
  message VCU_BWake_msg BCANwakeup;
  message VCU_PWake_msg pCANwakeup;
  message VCU_UWake_msg UCANwakeup;
    
  message VCU_USleep_msg UCANsleep;
  message VCU_ASleep_msg ACANsleep;
  message VCU_PSleep_msg PCANsleep;
  message VCU_BSleep_msg BCANsleep;
  message VCU_CSleep_msg CCANsleep;
  
  ACANwakeup.VCU_ACC_wakeup.phys=1;
  ACANwakeup.VCU_AEB_wakeup.phys=1;
  ACANwakeup.VCU_SCU_wakeup.phys=1;
  
  BCANwakeup.VCU_AML_wakeup.phys=1;
  BCANwakeup.VCU_BCU_wakeup.phys=1;
  BCANwakeup.VCU_Seat_wakeup.phys=1;
  BCANwakeup.VCU_Airbag_wakeup.phys=1;
    
  CCANwakeup.VCU_ACL_wakeup.phys=1;
  CCANwakeup.VCU_BRK_wakeup.phys=1;
    
  pCANwakeup.VCU_CCM_wakeup.phys=1;
  UCANwakeup.VCU_CLU_wakeup.phys=1;
  UCANwakeup.VCU_HMI_wakeup.phys=1;
  UCANwakeup.VCU_Panel_wakeup.phys=1;
    
  output(BCANwakeup);
  output(ACANwakeup);
  output(BCANwakeup);
  output(pCANwakeup);
  output(UCANwakeup);
  
  //sleep    
    UCANsleep.VCU_CLU_sleep.phys=0;
    UCANsleep.VCU_HMI_sleep.phys=0;
    UCANsleep.VCU_Panel_sleep.phys=0;
    ACANsleep.VCU_AEB_sleep.phys=0;
    ACANsleep.VCU_ACC_sleep.phys=0;
    ACANsleep.VCU_SCU_sleep.phys=0;
    BCANsleep.VCU_BCU_sleep.phys=0;
    BCANsleep.VCU_AML_sleep.phys=0;
    BCANsleep.VCU_Airbag_sleep.phys=0;
    BCANsleep.VCU_Seat_sleep.phys=0;
    CCANsleep.VCU_ACL_sleep.phys=0;
    CCANsleep.VCU_BRK_sleep.phys=0;
    PCANsleep.VCU_CCM_sleep.phys=0;
    
    output(UCANsleep);
    output(ACANsleep);
    output(BCANsleep);
    output(CCANsleep);
    output(PCANsleep);
  
}

void changesleep(){
  message VCU_AWake_msg ACANwakeup;
    message VCU_CWake_msg CCANwakeup;
    message VCU_BWake_msg BCANwakeup;
    message VCU_PWake_msg pCANwakeup;
    message VCU_UWake_msg UCANwakeup;
    message VCU_USleep_msg UCANsleep;
    message VCU_ASleep_msg ACANsleep;
    message VCU_PSleep_msg PCANsleep;
    message VCU_BSleep_msg BCANsleep;
    message VCU_CSleep_msg CCANsleep;
    
    UCANsleep.VCU_CLU_sleep.phys=1;
    UCANsleep.VCU_HMI_sleep.phys=1;
    UCANsleep.VCU_Panel_sleep.phys=1;
    ACANsleep.VCU_AEB_sleep.phys=1;
    ACANsleep.VCU_ACC_sleep.phys=1;
    ACANsleep.VCU_SCU_sleep.phys=1;
    BCANsleep.VCU_BCU_sleep.phys=1;
    BCANsleep.VCU_AML_sleep.phys=1;
    BCANsleep.VCU_Airbag_sleep.phys=1;
    BCANsleep.VCU_Seat_sleep.phys=1;
    CCANsleep.VCU_ACL_sleep.phys=1;
    CCANsleep.VCU_BRK_sleep.phys=1;
    PCANsleep.VCU_CCM_sleep.phys=1;
    
    output(UCANsleep);
    output(ACANsleep);
    output(BCANsleep);
    output(CCANsleep);
    output(PCANsleep);
    
    //wakeup 0  
    ACANwakeup.VCU_ACC_wakeup.phys=0;
    ACANwakeup.VCU_AEB_wakeup.phys=0;
    ACANwakeup.VCU_SCU_wakeup.phys=0;
  
    BCANwakeup.VCU_AML_wakeup.phys=0;
    BCANwakeup.VCU_BCU_wakeup.phys=0;
    BCANwakeup.VCU_Seat_wakeup.phys=0;
    BCANwakeup.VCU_Airbag_wakeup.phys=0;
    
    CCANwakeup.VCU_ACL_wakeup.phys=0;
    CCANwakeup.VCU_BRK_wakeup.phys=0;
    
    pCANwakeup.VCU_CCM_wakeup.phys=0;
    UCANwakeup.VCU_CLU_wakeup.phys=0;
    UCANwakeup.VCU_HMI_wakeup.phys=0;
    UCANwakeup.VCU_Panel_wakeup.phys=0;
    
    output(BCANwakeup);
    output(ACANwakeup);
    output(BCANwakeup);
    output(pCANwakeup);
    output(UCANwakeup);

}

//진단정보 요청//->0109수정
on message CAN3.P_CAN::CGW_DTC_PDTC_msg {
  message VCU_DTC_msg VCUDTC;
  VCUDTC.VCU_diagnosis.phys=1;  ///정상이면 1, 비정상이면2
  output(VCUDTC);
}


//HMI 시동
on message CAN3.CGW_HMI_VCU_Power_msg {  
  @sysvar::VCU_Rx::HMI_engine_on =  this.HMI_Engine_start;
  @sysvar::VCU_Rx::HMI_engine_off = this.HMI_Engine_sleep;
  

  //start msg 전송
  if (@sysvar::VCU_Rx::HMI_engine_on ==1){
    changewakeup();
  }
  //sLEEP msg 전송
  if (@sysvar::VCU_Rx::HMI_engine_off ==1){
    changesleep();
    $CGW::AEB_VCU_brk_pbar=0;
    @sysvar::VCU_Rx::AEB_brk=0; 
    @sysvar::VCU_Rx::HMI_engine_on=0;
    
  }
}


//운전자 
on message CAN3.CGW_ACL_Accel_msg {
  @sysvar::VCU_Rx::dr_accel_ped = this.ACL_ped_per;
  
  if (@sysvar::VCU_Rx::dr_accel_ped > 0){
    message VCU_ACCAccel_msg ACCOnAccel;
    ACCOnAccel.VCU_ACC_override.phys=1;  //운전자가 조작중임을 acc 한테 알림
    output(ACCOnAccel);
  }
  else {
    message VCU_ACCAccel_msg ACCOnAccel2;
    ACCOnAccel2.VCU_ACC_override.phys=0;  //운전자가 조작중임을 acc 한테 알림
    output(ACCOnAccel2);
  }
 
}

on message CAN3.CGW_BRK_Brk_msg {
  @sysvar::VCU_Rx::dr_brk_ped= this.BRK_ped_per;
  
  if (@sysvar::VCU_Rx::dr_brk_ped > 0 || @sysvar::VCU_Rx::dr_brkfull > 0){
    message VCU_ACCBrk_msg ACCOnBrk;
    ACCOnBrk.VCU_ACC_brksleep.phys=1;  //운전자가 조작중임을 acc 한테 알림
    output(ACCOnBrk);
  }
  else {
    message VCU_ACCBrk_msg ACCOnBrk;
    ACCOnBrk.VCU_ACC_brksleep.phys=0;  //운전자가 조작중임을 acc 한테 알림
    output(ACCOnBrk);
  }
}

on message CAN3.CGW_BRK_FBrk_msg {
  @sysvar::VCU_Rx::dr_brkfull = this.BRK_fullstatus;
  
  if (@sysvar::VCU_Rx::dr_brkfull > 0 || @sysvar::VCU_Rx::dr_brk_ped > 0 ){
    message VCU_ACCBrk_msg ACCOnBrk2;
    ACCOnBrk2.VCU_ACC_brksleep.phys=1;  //운전자가 조작중임을 acc 한테 알림
    output(ACCOnBrk2);

  }
  else {
     message VCU_ACCBrk_msg ACCOnBrk2;
    ACCOnBrk2.VCU_ACC_brksleep.phys=0;  //운전자가 조작중임을 acc 한테 알림
    output(ACCOnBrk2);
  }

}

//ACC->CCM ->VCU
on message CAN3.CCM_Accel_msg {
  @sysvar::VCU_Rx::ACC_accel = this.CCU_accel_trk;

}

on message CAN3.CCM_Brk_msg {
  @sysvar::VCU_Rx::ACC_brk = this.CCU_brk_pbar;

}

//AEB
on message CAN3.CGW_AEB_Brk_msg {
  @sysvar::VCU_Rx::AEB_brk = this.AEB_VCU_brk_pbar;

}
