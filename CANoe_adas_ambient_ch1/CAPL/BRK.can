/*@!Encoding:65001*/
includes
{
  
}

variables
{
  double brktemp;
  int tmp=0;
  msTimer BRKTimer;
}

on timer BRKTimer{     //pedal depth 계산
  message BRK_FBrk_msg  fullbrk;
  if (@sysvar::Panel::Ped_brk==1){
    brktemp=brktemp+0.05;
  }
  else {
    brktemp=0;
  }
  if (brktemp >100){
    brktemp=100;
  }

  tmp = (int)brktemp;
  $C_CAN::BRK::BRK_Brk_msg::BRK_ped_per=tmp;
  
  if (@sysvar::Panel::Ped_fullbrk==1){
    fullbrk.BRK_fullstatus=1;
  }
  else {
    fullbrk.BRK_fullstatus=0;
  }
   output(fullbrk);

}

on start
{
   setTimerCyclic(BRKTimer, 5);
}

on message can2.CGW_DTC_CDTC_msg   //진단코드 전송
{
   message BRK_DTC_msg msgOut;
    msgOut.BRK_diagnosis = 1;
  output(msgOut);
  
  
}

on message can2.C_CAN::CGW_VCU_CWake_msg //  ECU 작동 시작
{
  if($C_CAN::CGW::CGW_VCU_CWake_msg::VCU_BRK_wakeup == 1)
  {
    write("Brake Im alive");

  }
  
  
}
on message can2.C_CAN::CGW_VCU_CSleep_msg //  ECU 작동 종료
{
  if($C_CAN::CGW::CGW_VCU_CSleep_msg::VCU_BRK_sleep ==1)
  {
    brktemp=0;
    write("Brake Im End");
  }
}
