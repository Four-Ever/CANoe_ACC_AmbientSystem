/*@!Encoding:65001*/
includes
{
  
}

variables
{
  double brktemp;
  int tmp=0;
  msTimer BRKTimer;
}

on timer BRKTimer{
  if (@sysvar::Panel::Ped_brk==1){
    brktemp=brktemp+0.05;
  }
  else {
    brktemp=0;
  }
  if (brktemp >100){
    brktemp=100;
  }
  //write("%lf    ", brktemp);
  tmp = (int)brktemp;
  $C_CAN::BRK::BRK_Brk_msg::BRK_ped_per=tmp;
  //write("%d", tmp);

}

on start
{
   setTimerCyclic(BRKTimer, 5);
}

on message can2.CGW_PANEL_CDTC_msg
{
   message BRK_DTC_msg msgOut;
    msgOut.BRK_diagnosis = 1;
  output(msgOut);
  
  
}
