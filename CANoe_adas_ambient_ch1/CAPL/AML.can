/*@!Encoding:65001*/
includes
{
  
}

variables
{
  enum AML_Light_Sig{
    color_acc_emergency_color = 0, // emergency : Red
    color_acc_level1 = 1, // level1 : SkyBlue
    color_acc_level2 = 2, // level2 : Blue
    color_acc_level3 = 3, // level3 : Purple
    color_default = 4, // Default : Green
    ctrl_acc_emergency_light_off = 5, // emergency off sig
    ctrl_off = 6 // Off sig
  };

  enum Boolean{
    False = 0,
    True
  };
  // word now_light_state = color_default; // 시스템 변수
  byte Power_on_off_flag = False; // 엠비언트 Light On/Off 여부 Flag (시동 후에만 작동 해야함)
}
on start{ // init
  init();
  
}
on preStop{ // 종료 직전 수행
  init();
}
on message BCU_Color_msg
{
  if(Power_on_off_flag)
  {
    if(this.BCU_lightR) @sysvar::HMI_Input::ambi_color = color_acc_emergency_color;
    else if(this.BCU_lightSB) @sysvar::HMI_Input::ambi_color = color_acc_level1;
    else if(this.BCU_lightB) @sysvar::HMI_Input::ambi_color = color_acc_level2;
    else if(this.BCU_lightP) @sysvar::HMI_Input::ambi_color = color_acc_level3;
    else if(this.BCU_lightdefault_G) @sysvar::HMI_Input::ambi_color = color_default;
    else if(this.BCU_redlight_off) @sysvar::HMI_Input::ambi_color = ctrl_acc_emergency_light_off;
    // @sysvar::AML_Value::now_light_state
  }
}

/*
on signal_update BCU_lightR
{
    //write("Power_on_off_flag : %d, BCU_lightR : %d",Power_on_off_flag, $BCU_lightR);
    if (Power_on_off_flag && $BCU_lightR == True)
    {
      
      //@sysvar::AML_Value::now_light_state = color_acc_emergency_color;
      @sysvar::HMI_Input::ambi_color = color_acc_emergency_color;
    }
}
on signal_update BCU_lightSB
{
    if (Power_on_off_flag && $BCU_lightSB == True)
    {
      
        //@sysvar::AML_Value::now_light_state = color_acc_level1;
      @sysvar::HMI_Input::ambi_color = color_acc_level1;
    }
}
on signal_update BCU_lightB
{
    if (Power_on_off_flag && $BCU_lightB == True)
    {
        // @sysvar::AML_Value::now_light_state = color_acc_level2;
      @sysvar::HMI_Input::ambi_color = color_acc_level2;
    }
}
on signal_update BCU_lightP
{
    if (Power_on_off_flag && $BCU_lightP == True)
    {
        @sysvar::HMI_Input::ambi_color = color_acc_level3;
    }
}
on signal_update BCU_lightdefault_G
{
    if (Power_on_off_flag && $BCU_lightdefault_G == True)
    {
        @sysvar::HMI_Input::ambi_color = color_default;
    }
}
on signal_update BCU_redlight_off
{
    if (Power_on_off_flag && $BCU_redlight_off == True)
    {
        @sysvar::HMI_Input::ambi_color = ctrl_acc_emergency_light_off;
    }
}
*/
on message can1.CGW_VCU_BWake_msg // AML ECU 작동 시작
{
  write("AML Im alive");
  Power_on_off_flag = True;
  @sysvar::HMI_Input::ambi_color = color_default;
}
on message can1.CGW_VCU_BSleep_msg // AML ECU 작동 종료
{
  Power_on_off_flag = False;
  @sysvar::HMI_Input::ambi_color = ctrl_off;
}
on message can1.CGW_PANEL_BDTC_msg // AML 진단 정보 요청
{
  //if($CGW::Scenario_AMLrequest == 1)
  //{
    message AML_DTC_msg aml_dtc_msg;
    // 진단 내용 정의 필요
    aml_dtc_msg.AML_diagnosis = 1;
    output(aml_dtc_msg); // 전송
  //}
}
void init(){
  // 시스템 변수 및 전역변수 초기화
  Power_on_off_flag = False;
  @sysvar::HMI_Input::ambi_color = ctrl_off; // 불 OFF
}

// HMI @sysvar::HMI_Input::ambi_color 초기값 6으로 설정 요청(혜림)