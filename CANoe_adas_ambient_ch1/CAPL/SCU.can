/*@!Encoding:65001*/
includes
{
  
}


variables
{
  int on_flag; //합칠 때 0으로 변경
  int leadcar_flag ;
  int AEB_distance = 0;
}

void init(){
  on_flag = 0;
  leadcar_flag = 0;
  $A_CAN::SCU::SCU_Frdis_m = 250; // 값 2바이트로 변경, 패널 값을 제한하게끔 시스템변수 -> 변수하나 넣어서 처리
  $SCU::SCU_Frcrash_ns = 0;
  $SCU::SCU_PreVehicle = 0;
  $SCU::SCU_Rcrash_ns = 0;
  @LeadCarSimulation::MyCar_Pos = 0;
}

on start{
 
  init();
  //write("SCU on start step");
}

on message can6.CGW_VCU_AWake_msg{
  if(this.VCU_SCU_wakeup == 1){
    on_flag = 1;
    write("SCU ALIVE!!");
  }
}

on message can6.CGW_VCU_ASleep_msg{
  if(this.VCU_SCU_sleep == 1){
    //sleep 시 값 초기화
    init();
    write("SCU DIE!!");
  }
}

on message can6.CGW_VCU_Speed_Overr_msg{
  if(on_flag==1){
    @LeadCarSimulation::MyCar_Pos += (this.VCU_speed_kph *0.008333); //kph -> m/30ms
    AEB_distance = (int)(this.VCU_speed_kph * this.VCU_speed_kph * 0.008333 - 10);
  }
}

on message can6.CGW_PANEL_FCar_msg{ // 선행차 등장
 if(on_flag==1){
   //@LeadCarSimulation::MyCar_Pos = 0;
   @LeadCarSimulation::Set_LeadCar_Pos = 200;
   @LeadCarSimulation::LeadCar_Pos = @LeadCarSimulation::MyCar_Pos + @LeadCarSimulation::Set_LeadCar_Pos;
   leadcar_flag = 1;
 }
  
}

on sysvar_update LeadCarSimulation::LeadCar_Movement_Sg{
  if(on_flag==1 && leadcar_flag == 1){
    int cog_dist = 210;
    int distance = 0;
    @LeadCarSimulation::LeadCar_Pos += (@LeadCarSimulation::LeadCar_Movement_Sg*0.008333);
    //@LeadCarSimulation::MyCar_Pos +=@LeadCarSimulation::LeadCar_Movement_Sg;
    distance = (int)(@LeadCarSimulation::LeadCar_Pos - @LeadCarSimulation::MyCar_Pos);
    if(distance >=255)
      $SCU::SCU_Frdis_m = 255;
    else if(distance <=0)
      $SCU::SCU_Frdis_m = 0;
    else
      $SCU::SCU_Frdis_m = distance;
    
    //cog_dist 이하면 선행차 인지
    
    if(distance <= 0) {
      $SCU_Frcrash_ns = 22;
      on_flag= 0;
      leadcar_flag = 0;
    }
    
    if($SCU::SCU_Frdis_m <= cog_dist){
      $SCU::SCU_PreVehicle = 1;
    }
    else{
      $SCU::SCU_PreVehicle = 0;
    }
  }
}

on message can6.CGW_PANEL_FColl_msg{
 if(on_flag==1 && leadcar_flag == 1){
   @LeadCarSimulation::LeadCar_Pos = @LeadCarSimulation::MyCar_Pos + 10;
 }
  
}

on message can6.CGW_PANEL_AEB_msg{
 if(on_flag==1 && leadcar_flag == 1){

   @LeadCarSimulation::LeadCar_Pos = @LeadCarSimulation::MyCar_Pos + AEB_distance; //로직구현
 }
  
}

on message can6.CGW_PANEL_ACC_msg{
 if(on_flag==1 && leadcar_flag == 1){
   @LeadCarSimulation::LeadCar_Pos = @LeadCarSimulation::MyCar_Pos + 120;
 }
  
}

on message can6.CGW_PANEL_RColl_msg{
  //여기선 값을 바꿔주기만..
  //주기전송은 IL로 처리
  if(on_flag==1){
    if(this.Scenario_Rear_collision == 1){ // 박았을 떄
      $SCU::SCU_Rcrash_ns = 22; // 데이터베이스 분리해야 사용가능   
      on_flag = 0; // 종료
      leadcar_flag = 0;
    }
  }

}

on message can6.CGW_PANEL_ADTC_msg{ // 내부 메시지 SCU로 수정하긴 해야됨
  //if(on_flag == 1){
    message SCU_DTC_msg DTC_info;
    DTC_info.SCU_diagnosis = 0x001; // 문제없음
    //DTC_info.SCU_diagnosis = 0x002; // 오류
    output(DTC_info);
  //}
}