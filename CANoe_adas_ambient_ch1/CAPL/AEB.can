/*@!Encoding:65001*/
includes
{
  
}

variables
{
  msTimer tmrCycle_1;
  int speed; // 속도
  int impulse;
  int frontDistance;
  int isPower;
  int isFront;
  float k;
  int aebState;
  int airbagState;
}



on start
{
  setTimerCyclic(tmrCycle_1, 30);
  speed = 0;
  impulse = 0;
  frontDistance = 0;
  isPower = 0;
  isFront = 0;
  aebState = 0;
  airbagState = 0;
  k = 0.008;
}

// 작동 시작 이벤트
on message can6.A_CAN::CGW_VCU_AWake_msg
{
  isPower = 1;


}

// 작동 종료 이벤트
on message can6.A_CAN::CGW_VCU_ASleep_msg
{
  speed = 0;
  impulse = 0;
  frontDistance = 0;
  isPower = 0;
  isFront = 0;
  aebState = 0;
  airbagState = 0;
}

// 차량 속도 30주기
on message can6.A_CAN::CGW_VCU_Speed_Overr_msg
{
  speed = this.VCU_speed_kph;
  
}

//레이더 거리, 충돌감지 센서값 30주기
on message can6.A_CAN::SCU_Front_msg
{
  frontDistance = this.SCU_Frdis_m;
  isFront = this.SCU_PreVehicle;
  //if (impulse >=20)
    impulse = this.SCU_Frcrash_ns;
}

// 진단 요청 이벤트
on message can6.A_CAN::CGW_PANEL_ADTC_msg
{
  message AEB_DTC_msg msgOut;
  
  msgOut.AEB_diagnosis = 1;
  
  output(msgOut);
  
}

// 로직 30주기
// 충돌 감지AML , 긴급제동시 AML
on timer tmrCycle_1
{
  int stopDistance = 0;
  //write("Power:  %d Front %d",isPower,isFront);
  if (isPower == 1)
  {
    if (isFront == 1)
    {
      stopDistance = (speed*speed) * k;
      write("stopDistance : %d fronDistance : %d",stopDistance,frontDistance);
      if (stopDistance > frontDistance)
      {  
        message AEB_Brk_msg brakeMsgOut;
        brakeMsgOut.AEB_VCU_brk_pbar = 1;
        output(brakeMsgOut);
        aebState = 1;
        write("AEB ON");
        // TODO : 주기가 너무 길어서 안가면 수정   
        $AEB::AEB_BCU_amlctrl_req = 1; //주기 200
        $AEB::AEB_CLU_aebled = 1; // 주기 100
      }
      
      else
      {
        write("AEB OFF");
        if (aebState == 1)
        {
          message AEB_Brk_msg brakeMsgOut;
          brakeMsgOut.AEB_VCU_brk_pbar = 1;
          output(brakeMsgOut);
          aebState = 0;
        }
        // 주기가 너무 길어서 안가면 수정
        $AEB::AEB_BCU_amlctrl_req = 0;
        $AEB::AEB_CLU_aebled = 0;   
      }
      
      if (impulse >= 20)
      {
        if (airbagState == 0)
        {
          message AEB_Airbag_msg airbagMsgOut;
          airbagMsgOut.AEB_BCU_airbagctrl_req = 1;
          output(airbagMsgOut);
          // airbag터지면 AEB 동작 종료
          isPower = 0;
          write("air bag");
          airbagState = 1;
        }
        if (aebState == 1)
        {
          message AEB_Brk_msg brakeMsgOut;
          brakeMsgOut.AEB_VCU_brk_pbar = 1;
          output(brakeMsgOut);
          aebState = 0;
        }
      }

    }
    else
      {
        $AEB::AEB_BCU_amlctrl_req = 0;
        $AEB::AEB_CLU_aebled = 0;
        aebState = 0;
        if (aebState == 1)
        {
          message AEB_Brk_msg brakeMsgOut;
          brakeMsgOut.AEB_VCU_brk_pbar = 1;
          output(brakeMsgOut);
          aebState = 0;
        }
        
      }
  } 
}